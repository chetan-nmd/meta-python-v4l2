## conf/layer.conf
```bitbake
# We have a conf and classes directory, add to BBPATH
BBPATH .= ":${LAYERDIR}"

# We have recipes-* directories, add to BBFILES
BBFILES += "${LAYERDIR}/recipes-*/*/*.bb \
            ${LAYERDIR}/recipes-*/*/*.bbappend"

BBFILE_COLLECTIONS += "meta-python-v4l2"
BBFILE_PATTERN_meta-python-v4l2 = "^${LAYERDIR}/"
BBFILE_PRIORITY_meta-python-v4l2 = "6"

LAYERDEPENDS_meta-python-v4l2 = "core"
LAYERSERIES_COMPAT_meta-python-v4l2 = "mickledore"
```
